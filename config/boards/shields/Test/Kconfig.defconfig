## config/boards/shields/Test/Kconfig.defconfig
```kconfig
if SHIELD_KEYBALLBLE_R

config ZMK_KEYBOARD_NAME
    default "KeyballBLE_R"

config ZMK_SPLIT
    default y

config ZMK_SPLIT_ROLE_CENTRAL
    default y

endif

if SHIELD_KEYBALLBLE_L

config ZMK_KEYBOARD_NAME
    default "KeyballBLE_L"

config ZMK_SPLIT
    default y

endif


if SHIELD_KEYBALLBLE_DONGLE

config ZMK_KEYBOARD_NAME
    default "Keyball_Dongle"

config ZMK_SPLIT
    default y

config ZMK_SPLIT_ROLE_CENTRAL
    default y

config ZMK_SPLIT_BLE_CENTRAL_PERIPHERALS
    default 2

config ZMK_USB
    default y

config BT_MAX_CONN
    default 6

config BT_MAX_PAIRED
    default 6

endif

if SHIELD_KEYBALLBLE_R_PER

config ZMK_KEYBOARD_NAME
    default "KeyballBLE_R_Per"

config ZMK_SPLIT
    default y

endif

if SHIELD_KEYBALLBLE_L_PER

config ZMK_KEYBOARD_NAME
    default "KeyballBLE_L_Per"

config ZMK_SPLIT
    default y

endif
```

## config/boards/shields/Test/Kconfig.shield
```kconfig
config SHIELD_KEYBALLBLE_R
    def_bool $(shields_list_contains,KeyballBLE_R)

config SHIELD_KEYBALLBLE_L
    def_bool $(shields_list_contains,KeyballBLE_L)

config SHIELD_KEYBALLBLE_DONGLE
    def_bool $(shields_list_contains,KeyballBLE_dongle)

config SHIELD_KEYBALLBLE_R_PER
    def_bool $(shields_list_contains,KeyballBLE_R_per)

config SHIELD_KEYBALLBLE_L_PER
    def_bool $(shields_list_contains,KeyballBLE_L_per)
```

## config/boards/shields/ble/KeyballBLE_L/Kconfig.defconfig
```kconfig
if SHIELD_KEYBALLBLE_L

config ZMK_KEYBOARD_NAME
    default "KeyballBLE_L"

config ZMK_SPLIT
    default y

endif
```

## config/boards/shields/dongle/KeyballBLE_L_per/Kconfig.defconfig
```kconfig
if SHIELD_KEYBALLBLE_L_PER

config ZMK_KEYBOARD_NAME
    default "KeyballBLE_L_Per"

config ZMK_SPLIT
    default y

endif
```

## config/boards/shields/dongle/KeyballBLE_L_per/Kconfig.shield
```kconfig
config SHIELD_KEYBALLBLE_L_PER
    def_bool $(shields_list_contains,KeyballBLE_L_per)
```

## config/boards/shields/dongle/KeyballBLE_R_per/Kconfig.defconfig
```kconfig
if SHIELD_KEYBALLBLE_R_PER

config ZMK_KEYBOARD_NAME
    default "KeyballBLE_R_Per"

config ZMK_SPLIT
    default y

endif
```

## config/boards/shields/dongle/KeyballBLE_R_per/Kconfig.shield
```kconfig
config SHIELD_KEYBALLBLE_R_PER
    def_bool $(shields_list_contains,KeyballBLE_R_per)
```

## config/boards/shields/dongle/KeyballBLE_dongle/Kconfig.defconfig
```kconfig
if SHIELD_KEYBALLBLE_DONGLE

config ZMK_KEYBOARD_NAME
    default "Keyball_Dongle"

config ZMK_SPLIT
    default y

config ZMK_SPLIT_ROLE_CENTRAL
    default y

config ZMK_SPLIT_BLE_CENTRAL_PERIPHERALS
    default 2

config ZMK_USB
    default y

config BT_MAX_CONN
    default 6

config BT_MAX_PAIRED
    default 6

endif
```

## config/boards/shields/dongle/KeyballBLE_dongle/Kconfig.shield
```kconfig
config SHIELD_KEYBALLBLE_DONGLE
    def_bool $(shields_list_contains,KeyballBLE_dongle)
```
